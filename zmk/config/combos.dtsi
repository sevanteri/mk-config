#include "keypos.h"

#define COMBO_BASE(_NAME, _BIND, _KEYS, _TIMEOUT) \
    combo_##_NAME { \
        timeout-ms = <_TIMEOUT>; \
        bindings = <_BIND>; \
        key-positions = <_KEYS>; \
        slow-release; \
    };

#define COMB(_NAME, _BIND, _KEYS) COMBO_BASE(_NAME, _BIND, _KEYS, 25)
#define VERT(_NAME, _BIND, _KEYS) COMBO_BASE(_NAME, _BIND, _KEYS, 100)

combos {
    compatible = "zmk,combos";

// right hand top row {{{
COMB(aring,    &kp FI_ARNG,       P_H  P_U)
COMB(acut,     &kp FI_ACUT,       P_K  P_O)
/* COMB(ASTERISK, LSFT(FI_QUOT), P_U  P_I  P_O) */
COMB(rtab,     &kp TAB,   P_I P_O)


//}}}
// right hand home row {{{

COMB(lessthan,    &kp FI_LABK,             P_H P_J)
COMB(greaterthan, &kp FI_RABK,             P_H P_K)
COMB(slash,       &tm LCTRL FI_SLSH, P_J P_K)
COMB(quot,        &tm LGUI FI_QUOT,  P_K P_L)
COMB(equals,      &tm LALT FI_EQL,   P_L P_OE)


VERT(plus,       &kp FI_PLUS,  P_TR_2  P_L)
COMB(question,   &kp FI_QUES,  P_TR_2  P_OE)
COMB(backslash,  &kp FI_BSLS,  P_TR_2  P_J  P_K)

COMB(squarebraceright,  &kp RA(N9),  P_J  P_M)
COMB(parenright,        &kp LS(N9),  P_M  P_DOT)
COMB(curlybraceright,   &kp RA(N0),  P_J  P_L)

//}}}
// right hand bottom row {{{

COMB(amp,          &kp FI_AMPR,  P_N     P_M)
COMB(semicolon,    &kp FI_SCLN,  P_M     P_COMM)
COMB(doublecolon,  &kp FI_COLN,  P_COMM  P_DOT)
COMB(underscore,   &kp FI_UNDS,  P_DOT   P_MINS)

COMB(dotdotslash,  &mDdslash,    P_TR_2  P_DOT)

//}}}

// left hand top row {{{
COMB(we_tab,  &kp TAB,  P_W  P_E)

COMB(tilde,   &mDouble_tilde,   P_R P_T)

/* COMB(MSBTN1, KBTN1, P_F P_R) */
/* COMB(MSBTN2, KBTN2, P_E P_D) */
//}}}
// left hand home row {{{
COMB(exclamationp,  &kp FI_EXLM,  P_A  P_S)
COMB(dquotes,       &kp FI_DQUO,  P_S  P_D)
COMB(hash,          &lt _NAV FI_HASH,  P_D  P_F)
COMB(percentg,      &kp FI_PERC,  P_F  P_G)

COMB(squarebraceleft,  &kp RA(N8),  P_F  P_V)
COMB(parenleft,        &kp LS(N8),  P_X  P_V)
COMB(curlybraceleft,   &kp RA(N7),  P_S  P_F)

// thumbs
COMB(thumb_ctl_sft,    &kp LC(LSHFT),   P_TL_1 P_S)
COMB(thumb_alt_sft,    &kp LA(LSHFT),   P_TL_2 P_S)
COMB(thumb_alt_ctl,    &kp LA(LCTRL),   P_TL_2 P_A)
COMB(thumb_gui_ctl,    &kp LG(LCTRL),   P_TL_3 P_A)
COMB(thumb_gui_sft,    &kp LG(LSHFT),   P_TL_3 P_S)
COMB(thumb_gui_alt,    &kp LG(LALT),   P_TL_3 P_Z)

//}}}
// left hand bottow row {{{
COMB(pipe,     &kp FI_PIPE,  P_X     P_Z)
COMB(at,       &kp FI_AT,     P_X     P_C)
COMB(dollar,   &kp FI_DLR,     P_C     P_V)

//}}}

// both hands {{{
COMB(sleep,  &kp C_SLEEP,  P_Q     P_P)
/* COMB(WAKE,   KC_WAKE,  P_W     P_O) */

COMB(reset,  &bootloader,    P_V P_B P_N P_M)

/* COMB(SQUAREBRACEBOTH,  P_SQUAREBRACEBOTH,  P_X  P_V  P_M  P_DOT) */
/* COMB(CURLYBRACEBOTH,   P_CURLYBRACEBOTH,   P_S  P_F  P_J  P_L) */
/* COMB(PARENSBOTH,       P_PARENSBOTH,       P_S  P_D  P_F  P_J  P_K  P_L) */

//}}}

// string combos, double handed: thumb2 plus letter from other hand {{{

/* SUBS(GMAIL,  "pete.sevander@gmail.com",  P_TR_2  P_G) */

/* SUBS(OULD,  "ould",  P_U  P_O) */
COMB(iapo,  &mIquote,  P_TR_2  P_I)
/* SUBS(THE,   "the",   P_T  P_H) */

// python

/* SUBS(IMPORT,  "import",  P_TL_2  P_I) */
/* SUBS(FROM,    "from",    P_TR_2  P_F) */
/* SUBS(class,   "class",   P_TR_2  P_C) */
/* SUBS(self,    "self",    P_TR_2  P_S) */

/* SUBS(def,     "def ():" SLEFT SLEFT SLEFT,  P_TR_2  P_D) */
/* SUBS(dunder,  "____" SLEFT SLEFT,           P_TL_2  P_MINS) */

// }}}

// randoms {{{
COMB(mute,   &kp C_MUTE,  P_QUOT  P_AE)

COMB(eject, &kp C_EJECT, P_TAB P_ESC)

/* COMB(MOUS3,   KC_BTN3,   KC_BTN1 KC_BTN2) */

/* COMB(WORDCAPS, WORDCAPS,   KC_LSFT CTRLESC KC_TAB) */


// alt + number for browser tabs and tmux {{{
COMB(altn2 ,  &kp LA(N1) , P_TAB  P_Q)
COMB(altn3 ,  &kp LA(N2) , P_TAB  P_W)
COMB(altn4 ,  &kp LA(N3) , P_TAB  P_E)
COMB(altn5 ,  &kp LA(N4) , P_TAB  P_R)
COMB(altn6 ,  &kp LA(N5) , P_TAB  P_T)
COMB(altn7 ,  &kp LA(N6) , P_QUOT P_Y)
COMB(altn8 ,  &kp LA(N7) , P_QUOT P_U)
COMB(altn9 ,  &kp LA(N8) , P_QUOT P_I)
COMB(altn10 , &kp LA(N9) , P_QUOT P_O)
COMB(altn1 ,  &kp LA(N0) , P_QUOT P_P)
//}}}
//}}}

// vertical combos {{{

// right hand
VERT(ctrlsix,   &kp LC(N6),     P_H  P_Y)

VERT(nexttab, &kp LC(TAB),     P_K P_COMM)
VERT(prevtab, &kp LC(LS(TAB)), P_K P_I)
VERT(wbak,    &kp K_BACK,      P_U P_J)
VERT(wfwd,    &kp K_FORWARD,   P_O P_L)
// C_AC_BACK/FORWARD

// left hand
VERT(diaeresis,  &kp FI_DIAE,  P_G  P_T)
VERT(sect,       &kp FI_SECT,  P_A  P_Q)

// left hand thumb
VERT(codeblk,  &mDouble_acut,  P_TL_2 P_TUL_2)


// }}}

};
